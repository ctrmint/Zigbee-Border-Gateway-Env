## firmware/main/Kconfig.projbuild
```kconfig
choice ZB_GW_RCP_CHIP
    prompt "Zigbee gateway RCP chip for auto update"
    depends on AUTO_UPDATE_RCP
    default ZB_GW_RCP_CHIP_ESP32H2
    help
        Select the RCP chip connected to the Zigbee gateway.

    config ZB_GW_RCP_CHIP_ESP32H2
        bool "ESP32-H2"
        help
            ESP32-H2 is the RCP chip connected to the Zigbee gateway.

    config ZB_GW_RCP_CHIP_ESP32C6
        bool "ESP32-C6"
        help
            ESP32-C6 is the RCP chip connected to the Zigbee gateway.
endchoice

menu "Local gateway API"
config GW_API_TOKEN
    string "Bearer token (at least 32 characters)"
    default ""
    help
        Required. Generate with python3 -c 'import secrets; print(secrets.token_hex(32))'.
        HTTP is for an isolated trusted LAN only; see SECURITY.md.
endmenu
```

## firmware/sdkconfig.defaults.esp32s3
```kconfig
CONFIG_ZB_RADIO_SPINEL_UART=y
CONFIG_OPENTHREAD_SPINEL_ONLY=y
CONFIG_AUTO_UPDATE_RCP=n
CONFIG_DEFAULT_PIN_TO_RCP_RESET=7
CONFIG_DEFAULT_PIN_TO_RCP_BOOT=8
CONFIG_DEFAULT_PIN_TO_RCP_TX=17
CONFIG_DEFAULT_PIN_TO_RCP_RX=18
CONFIG_RCP_PARTITION_NAME="rcp_fw"
CONFIG_EXAMPLE_CONNECT_WIFI=y
CONFIG_EXAMPLE_WIFI_SSID="configure-in-menuconfig"
CONFIG_EXAMPLE_WIFI_PASSWORD=""
CONFIG_ZB_EXAMPLE_PRIMARY_CHANNEL=20
```
